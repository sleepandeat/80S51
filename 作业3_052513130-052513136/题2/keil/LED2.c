#include<reg51.h>
sbit LED=P1^0;
sbit SW=P3^0;    
unsigned int i;
unsigned char num;
/*------------------------------------------------
                    定时器初始化子程序
------------------------------------------------*/
void Init_Timer0(void)
{
 TMOD |= 0x01;	  //使用模式1，16位定时器，使用"|"符号可以在使用多个定时器时不受影响		     
 TH0=(65536-500)/256;		  //重新赋值 12M晶振计算，指令周期1uS，
 TL0=(65536-500)%256;   
 EA=1;            //总中断打开
 ET0=1;           //定时器中断打开
 TR0=1;           //定时器开关打开
}
/*------------------------------------------------
                    主程序
------------------------------------------------*/
main()
{
 Init_Timer0();
 SW=1;
 while(1)
 {
 	if(!SW)
	{
		num=0;
		
	}
	else
	{
		num=500;
	} 
	if(i==1000)
	{
		i=num;
		LED=~LED;
	}          
 }
	 
}

/*------------------------------------------------
                 定时器中断子程序
------------------------------------------------*/
void Timer0_isr(void) interrupt 1 using 1
{
 TH0=(65536-500)/256;		  //重新赋值 12M晶振计算，指令周期1uS，
 TL0=(65536-500)%256;         //半个周期500uS，即定时500次
 i++;
            

}


